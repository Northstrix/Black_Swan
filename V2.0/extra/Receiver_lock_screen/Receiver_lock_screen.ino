/*
The Black Swan Project
Distributed under the MIT License
© Copyright Maxim Bortnikov 2023
For more information please visit
https://github.com/Northstrix/Black_Swan
Required libraries:
https://github.com/adafruit/Adafruit-GFX-Library
https://github.com/adafruit/Adafruit_BusIO
https://github.com/adafruit/Adafruit_ILI9341
https://github.com/adafruit/Adafruit-ST7735-Library
https://github.com/techpaul/PS2KeyAdvanced
https://github.com/techpaul/PS2KeyMap
*/
#include <SPI.h>
#include <Adafruit_GFX.h>
#include <Adafruit_ST7735.h>
#define TFT_CS1         5
#define TFT_RST1        19
#define TFT_DC1         22
Adafruit_ST7735 tft = Adafruit_ST7735(TFT_CS1, TFT_DC1, TFT_RST1);

void disp_centered_text(String t_disp, int y){
   int16_t x1, y1;
   uint16_t w, h;
   tft.getTextBounds(t_disp, 160, 0, &x1, &y1, &w, &h);
   tft.setCursor(80 - (w / 2), y);
   tft.print(t_disp);
}

const uint16_t Dublin PROGMEM [160][129] = {
{19446,19447,19447,21527,21527,21527,21559,21559,21559,21527,21560,21560,21592,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10337,255},
{19446,19446,19446,21527,21527,21527,21559,21559,21527,21527,21528,21560,21560,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8290,255},
{19446,19446,19446,21527,21527,21527,21527,21527,21527,21527,21559,21559,21560,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10369,255},
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{10829,10797,10797,10797,10797,10797,10797,10797,10797,8717,8717,8716,8717,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2146,255}
};

const bool Inscription PROGMEM [154][20] = {
{0,0,0,0,0,0,0,0,0,0,0,0,0,0,0,0,0,0,0,1},
{0,0,0,0,0,0,0,0,0,0,0,0,0,0,0,0,0,0,0,1},
{0,0,0,0,0,0,0,0,0,0,0,0,0,0,0,0,0,0,0,1},
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{1,1,1,1,0,0,0,0,0,0,0,0,0,0,0,0,0,0,0,1}
};

void draw_lock_screen(){
  for (int i = 0; i < 160; i++){
    for (int j = 0; j < 128; j++){
      tft.drawPixel(i, j, Dublin[i][j]);
    }
  }
}

void setup() {
  tft.initR(INITR_BLACKTAB);
  tft.setRotation(1);
  tft.fillScreen(0x0000);
  draw_lock_screen();
  disp_centered_text("Power The Transmitter Up", 115);
  for (int i = 0; i < 154; i++) {
    for (int j = 0; j < 19; j++) {
      if (Inscription[i][j] == 0)
        tft.drawPixel(i + 3, j + 8, Dublin[(esp_random() % 160)][esp_random() % 128]);
    }
  }
}

int c, v;
void loop() {
    c = esp_random() % 154;
    v = esp_random() % 19;
    if (Inscription[c][v] == 0){
      tft.drawPixel(c + 3, v + 8, Dublin[(esp_random() % 160)][esp_random() % 128]);
    }
}
